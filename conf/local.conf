## conf/local.conf
```bitbake
include "application"

slick.dbs {
  default {
    db {
      url = "jdbc:mysql://localhost:3306/groups?useSSL=false&useUnicode=true&characterEncoding=utf8"
      user = "groups"
      password = "groups"
    }
  }
}
db {
  default {
    url = "jdbc:mysql://localhost:3306/groups?useSSL=false&useUnicode=true&characterEncoding=utf8"
    user = "groups"
    password = "groups"
  }
}
```
